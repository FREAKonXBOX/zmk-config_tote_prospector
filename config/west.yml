## config/west.yml
```yaml
manifest:
  remotes:
    - name: zmkfirmware
      url-base: https://github.com/zmkfirmware
    - name: carrefinho
      url-base: https://github.com/carrefinho
    - name: prospector
      url-base: https://github.com/t-ogura
  projects:
    - name: zmk
      remote: zmkfirmware
      revision: main
      import: app/west.yml
    - name: prospector-zmk-module
      remote: carrefinho
      revision: main
    - name: prospector-zmk-module
      remote: prospector
      revision: v1.0.0
      path: modules/prospector-zmk-module
  self:
    path: config
```
